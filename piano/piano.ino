/*
  Buzzer Piano
  Description: This Arduino sketch plays different musical notes on a buzzer
               when you press corresponding buttons. Each button is assigned
               to play a specific note: C, D, E, or F. The buttons are connected
               to pins D7, D6, D4, and D2. The notes are generated by controlling
               the frequency of the buzzer.
  Hardware: RoboUNO (on-board buzzer on D9 and onboard buttons on D7, D6, D4, and D2)
  Library: -
  Difficulty: XX/10
  Author: ROBO
  Date: August 11, 2023
*/

#define BUZZER_PIN 9  // Buzzer pin, connected to pin D9

#define BUTTON_A 7  // Button for note C, connected to pin D7
#define BUTTON_B 6  // Button for note D, connected to pin D6
#define BUTTON_C 4  // Button for note E, connected to pin D4
#define BUTTON_D 2  // Button for note F, connected to pin D2

#define NOTE_C 523  // Frequency for note C in Hertz
#define NOTE_D 587  // Frequency for note D in Hertz
#define NOTE_E 659  // Frequency for note E in Hertz
#define NOTE_F 698  // Frequency for note F in Hertz

// one octave lower
// #define NOTE_C 261  // Frequency for note C in Hertz
// #define NOTE_D 294  // Frequency for note D in Hertz
// #define NOTE_E 329  // Frequency for note E in Hertz
// #define NOTE_F 349  // Frequency for note F in Hertz

void setup() {
  pinMode(BUTTON_A, INPUT_PULLUP);  // Set the buttons as inputs with pull-up resistors
  pinMode(BUTTON_B, INPUT_PULLUP);
  pinMode(BUTTON_C, INPUT_PULLUP);
  pinMode(BUTTON_D, INPUT_PULLUP);

  pinMode(BUZZER_PIN, OUTPUT);  // Set the buzzer pin as an output
}

void loop() {
  // Read the state of each button pin and play the corresponding note it it's pressed
  if (digitalRead(BUTTON_A) == LOW) {
    tone(BUZZER_PIN, NOTE_C);  // Play note C
  } else if (digitalRead(BUTTON_B) == LOW) {
    tone(BUZZER_PIN, NOTE_D);  // Play note D
  } else if (digitalRead(BUTTON_C) == LOW) {
    tone(BUZZER_PIN, NOTE_E);  // Play note E
  } else if (digitalRead(BUTTON_D) == LOW) {
    tone(BUZZER_PIN, NOTE_F);  // Play note F
  } else {
    noTone(BUZZER_PIN);  // Turn off the buzzer if no button is pressed
  }
}
